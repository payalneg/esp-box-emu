## components/esp-box/Kconfig
```kconfig
menu "Esp-Box Configuration"

    choice ESP_BOX_BOARD
        prompt "Target board"
        default ESP_BOX_BOARD_ESPBOX

        config ESP_BOX_BOARD_ESPBOX
            bool "ESP32-S3-BOX / BOX-3"

        config ESP_BOX_BOARD_WAVESHARE_28
            bool "Waveshare ESP32-S3-Touch-LCD-2.8"
    endchoice

    config ESP_BOX_INTERRUPT_STACK_SIZE
        int "Interrupt stack size"
        default 4096
        help
            Size of the stack used for the interrupt handler. Used by the touch
            callback.
endmenu
```

## components/waveshare-p4-bsp/Kconfig
```kconfig
menu "Board Support Package (Waveshare ESP32-P4 4.3)"

    config BSP_ERROR_CHECK
        bool "Enable error check in BSP"
        default y
        help
            Error check assert the application before returning the error code.

    menu "I2C"
        config BSP_I2C_NUM
            int "I2C peripheral index"
            default 1
            range 0 1
            help
                ESP32P4 has two I2C peripherals, pick the one you want to use.

        config BSP_I2C_FAST_MODE
            bool "Enable I2C fast mode"
            default y
            help
                I2C has two speed modes: normal (100kHz) and fast (400kHz).

        config BSP_I2C_CLK_SPEED_HZ
            int
            default 400000 if BSP_I2C_FAST_MODE
            default 100000
    endmenu

    menu "I2S"
        config BSP_I2S_NUM
            int "I2S peripheral index"
            default 1
            range 0 2
            help
                ESP32P4 has three I2S peripherals, pick the one you want to use.
    endmenu

    menu "uSD card"
        config BSP_SD_FORMAT_ON_MOUNT_FAIL
            bool "Format uSD card if mounting fails"
            default n

        config BSP_SD_MOUNT_POINT
            string "uSD card mount point"
            default "/sdcard"
    endmenu

    menu "Display"
        config BSP_LCD_DPI_BUFFER_NUMS
            int "Number of DPI frame buffers"
            default 1
            range 1 3

        config BSP_DISPLAY_BRIGHTNESS_LEDC_CH
            int "LEDC channel index"
            default 1
            range 0 7
    endmenu

endmenu
```

## sdkconfig.defaults.waveshare_p4
```kconfig
# Waveshare ESP32-P4-WIFI6-Touch-LCD-4.3 board defaults
# Build: idf.py -DBOARD_TARGET=WAVESHARE_P4 set-target esp32p4

CONFIG_IDF_TARGET="esp32p4"
CONFIG_IDF_EXPERIMENTAL_FEATURES=y

CONFIG_ESP32P4_SELECTS_REV_LESS_V3=y
CONFIG_ESP32P4_REV_MIN_1=y

# Flash
CONFIG_ESPTOOLPY_FLASHMODE_QIO=y
CONFIG_ESPTOOLPY_FLASHSIZE_16MB=y

# PSRAM
CONFIG_SPIRAM=y
CONFIG_SPIRAM_SPEED_200M=y
CONFIG_SPIRAM_XIP_FROM_PSRAM=y

# Cache
CONFIG_CACHE_L2_CACHE_256KB=y
CONFIG_CACHE_L2_CACHE_LINE_128B=y

# Partition table
CONFIG_PARTITION_TABLE_CUSTOM=y
CONFIG_PARTITION_TABLE_CUSTOM_FILENAME="partitions.csv"

# FreeRTOS
CONFIG_FREERTOS_HZ=1000

# Watchdogs — disable for emulators (long frames)
# CONFIG_ESP_INT_WDT is not set
# CONFIG_ESP_TASK_WDT_EN is not set

# Main task
CONFIG_ESP_MAIN_TASK_STACK_SIZE=30000

# FATFS
CONFIG_FATFS_LFN_HEAP=y
CONFIG_FATFS_VFS_FSTAT_BLKSIZE=16384
CONFIG_FATFS_USE_FASTSEEK=y
CONFIG_FATFS_ALLOC_PREFER_EXTRAM=y
CONFIG_FATFS_SECTOR_4096=y

# LVGL
CONFIG_LV_COLOR_DEPTH_16=y
CONFIG_LV_OS_FREERTOS=y
CONFIG_LV_USE_CLIB_MALLOC=y
CONFIG_LV_USE_CLIB_STRING=y
CONFIG_LV_USE_CLIB_SPRINTF=y
CONFIG_LV_DEF_REFR_PERIOD=16
CONFIG_LV_MEM_SIZE_KILOBYTES=50
CONFIG_LV_DRAW_SW_DRAW_UNIT_CNT=2
CONFIG_LV_ATTRIBUTE_FAST_MEM_USE_IRAM=y
CONFIG_LV_FONT_MONTSERRAT_14=y

# Performance
CONFIG_COMPILER_OPTIMIZATION_PERF=y

# SPI flash
CONFIG_SPI_FLASH_SUPPORT_GD_CHIP=y

# Debug
CONFIG_FREERTOS_VTASKLIST_INCLUDE_COREID=y
CONFIG_FREERTOS_GENERATE_RUN_TIME_STATS=y
```
